#include <behaviors.dtsi>
#include <dt-bindings/zmk/keys.h>
#include <dt-bindings/zmk/bt.h>

/ {
    keymap {
        compatible = "zmk,keymap";

        default_layer {
            bindings = < 
                &kp KP_Q  &kp KP_W  &kp KP_E  &kp KP_R  &kp KP_T  &kp KP_Y  
                &kp KP_U  &kp KP_I  &kp KP_O  &kp KP_P  &kp KP_A  &kp KP_S  &kp KP_D  
                &kp KP_F  &kp KP_G  &kp KP_H  &kp KP_J  &kp KP_K  &kp KP_L  &kp KP_Z  
                &bt BT_SEL 0 &bt BT_SEL 1 &bt BT_SEL 2
        };
    };
};